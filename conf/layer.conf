## conf/layer.conf
```bitbake
# We have a conf and classes directory, add to BBPATH
BBPATH .= ":${LAYERDIR}"
# We have recipes-* directories, add to BBFILES
BBFILES += "${LAYERDIR}/recipes-*/*/*.bb"

#BBFILE_COLLECTIONS += "redhawk"
#BBFILE_PATTERN_core = "^${LAYERDIR}/"
#BBFILE_PRIORITY_core = "5"

# This should only be incremented on significant changes that will
# cause compatibility issues with other layers
#LAYERVERSION_core = "1"

# Set a variable to get to the top of the metadata location
#COREBASE = '${@os.path.normpath("${LAYERDIR}/../")}'
```
